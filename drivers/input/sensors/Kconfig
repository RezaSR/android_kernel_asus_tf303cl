## drivers/input/sensors/Kconfig
```kconfig
#
# Sensor driver configuration
#

config SENSORS_AK09911
        tristate "AK09911 compass support"
        default n
        depends on I2C
        help
          If you say yes here you get support for Asahi Kasei's
          orientation sensor AK09911.

config SENSORS_CAP1106
        tristate "SMSC CAP1106"
        depends on I2C
        help
          Say yes if you want SMSC 1106 cap sensor driver.
          This is for i2c connected version. If unsure, say N here.
          To compile this driver as a module, choose m here. The module will
          be called cap1106.
```
